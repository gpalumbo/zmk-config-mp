## boards/shields/bfo9000_macropad/Kconfig.shield
```kconfig
# Copyright (c) 2020 The ZMK Contributors
# SPDX-License-Identifier: MIT

config SHIELD_BFO9000_MACROPAD
    def_bool $(shields_list_contains,bfo9000_macropad)
```

## boards/shields/soyuz/Kconfig.defconfig
```kconfig
# Copyright (c) 2024 The ZMK Contributors
# SPDX-License-Identifier: MIT

if SHIELD_SOYUZ

config ZMK_KEYBOARD_NAME
    default "Soyuz Numpad"

endif
```
